AUTOSAR XML (schema 4.0)
package /Final_project_BSW
  module config Dio
    ecuc param conf container DioConfig: destination=AUTOSAR/Final_project_BSW/Dio/DioConfig
      ecuc param conf container DioPort_0: destination=AUTOSAR/Final_project_BSW/Dio/DioConfig/DioPort/DioPort_0
        ecuc integer param value DioPortId: value=5
        8 x ecuc param conf container:
          DioChannel_0: destination=AUTOSAR/Final_project_BSW/Dio/DioConfig/DioPort/DioPort_0/DioChannel/DioChannel_0
            ecuc integer param value DioChannelId: value=0
          DioChannel_1: destination=AUTOSAR/Final_project_BSW/Dio/DioConfig/DioPort/DioPort_0/DioChannel/DioChannel_1
            ecuc integer param value DioChannelId: value=1
          DioChannel_2: destination=AUTOSAR/Final_project_BSW/Dio/DioConfig/DioPort/DioPort_0/DioChannel/DioChannel_2
            ecuc integer param value DioChannelId: value=2
          DioChannel_3: destination=AUTOSAR/Final_project_BSW/Dio/DioConfig/DioPort/DioPort_0/DioChannel/DioChannel_3
            ecuc integer param value DioChannelId: value=3
          DioChannel_4: destination=AUTOSAR/Final_project_BSW/Dio/DioConfig/DioPort/DioPort_0/DioChannel/DioChannel_4
            ecuc integer param value DioChannelId: value=4
          DioChannelGroup_0: destination=AUTOSAR/Final_project_BSW/Dio/DioConfig/DioPort/DioPort_0/DioChannelGroup/DioChannelGroup_0
            ecuc string param value DioChannelGroupIdentification: value=String
            ecuc integer param value DioPortMask: value=1
            ecuc integer param value DioPortOffset: value=0
          DioChannelGroup_1: destination=AUTOSAR/Final_project_BSW/Dio/DioConfig/DioPort/DioPort_0/DioChannelGroup/DioChannelGroup_1
            ecuc string param value DioChannelGroupIdentification: value=String
            ecuc integer param value DioPortMask: value=14
            ecuc integer param value DioPortOffset: value=1
          DioChannelGroup_2: destination=AUTOSAR/Final_project_BSW/Dio/DioConfig/DioPort/DioPort_0/DioChannelGroup/DioChannelGroup_2
            ecuc string param value DioChannelGroupIdentification: value=string
            ecuc integer param value DioPortMask: value=16
            ecuc integer param value DioPortOffset: value=4
    ecuc param conf container DioGeneral: destination=AUTOSAR/Final_project_BSW/Dio/DioGeneral
      ecuc boolean param value DioDevErrorDetect: value=0
      ecuc boolean param value DioFlipChannelApi: value=1
      ecuc boolean param value DioVersionInfoApi: value=0
