AUTOSAR XML (schema 4.0)
package /Final_project_BSW
  module config Port
    ecuc param conf container PortConfigSet: destination=AUTOSAR/Final_project_BSW/Port/PortConfigSet
      6 x ecuc param conf container:
        PortContainer_0: destination=AUTOSAR/Final_project_BSW/Port/PortConfigSet/PortContainer/PortContainer_0
          ecuc integer param value PortNumberOfPortPins: value=1
          8 x ecuc param conf container:
            PortPin_0: destination=AUTOSAR/Final_project_BSW/Port/PortConfigSet/PortContainer/PortContainer_0/PortPin/PortPin_0
              ecuc enumeration param value PortPinDirection
              ecuc boolean param value PortPinDirectionChangeable: value=0
              ecuc integer param value PortPinId: value=1
              ecuc enumeration param value PortPinInitialMode
              ecuc enumeration param value PortPinLevelValue
              ecuc enumeration param value PortPinMode
              ecuc boolean param value PortPinModeChangeable: value=0
              ecuc enumeration param value PortPinInputPullResistor: value=PORT_PIN_IN_PULL_UP
            PortPin_1: destination=AUTOSAR/Final_project_BSW/Port/PortConfigSet/PortContainer/PortContainer_0/PortPin/PortPin_1
              ecuc enumeration param value PortPinDirection: value=PORT_PIN_OUT
              ecuc boolean param value PortPinDirectionChangeable: value=0
              ecuc integer param value PortPinId: value=2
              ecuc enumeration param value PortPinInitialMode: value=PORT_PIN_MODE_DIO
              ecuc enumeration param value PortPinLevelValue: value=PORT_PIN_LEVEL_LOW
              ecuc enumeration param value PortPinMode: value=PORT_PIN_MODE_DIO
              ecuc boolean param value PortPinModeChangeable: value=0
              ecuc enumeration param value PortPinInputPullResistor
            PortPin_2: destination=AUTOSAR/Final_project_BSW/Port/PortConfigSet/PortContainer/PortContainer_0/PortPin/PortPin_2
              ecuc enumeration param value PortPinDirection: value=PORT_PIN_OUT
              ecuc boolean param value PortPinDirectionChangeable: value=0
              ecuc integer param value PortPinId: value=3
              ecuc enumeration param value PortPinInitialMode: value=PORT_PIN_MODE_DIO
              ecuc enumeration param value PortPinLevelValue: value=PORT_PIN_LEVEL_LOW
              ecuc enumeration param value PortPinMode: value=PORT_PIN_MODE_DIO
              ecuc boolean param value PortPinModeChangeable: value=0
              ecuc enumeration param value PortPinInputPullResistor
            PortPin_3: destination=AUTOSAR/Final_project_BSW/Port/PortConfigSet/PortContainer/PortContainer_0/PortPin/PortPin_3
              ecuc enumeration param value PortPinDirection: value=PORT_PIN_OUT
              ecuc boolean param value PortPinDirectionChangeable: value=0
              ecuc integer param value PortPinId: value=4
              ecuc enumeration param value PortPinInitialMode: value=PORT_PIN_MODE_DIO
              ecuc enumeration param value PortPinLevelValue: value=PORT_PIN_LEVEL_LOW
              ecuc enumeration param value PortPinMode: value=PORT_PIN_MODE_DIO
              ecuc boolean param value PortPinModeChangeable: value=0
              ecuc enumeration param value PortPinInputPullResistor
            PortPin_4: destination=AUTOSAR/Final_project_BSW/Port/PortConfigSet/PortContainer/PortContainer_0/PortPin/PortPin_4
              ecuc enumeration param value PortPinDirection: value=PORT_PIN_IN
              ecuc boolean param value PortPinDirectionChangeable: value=0
              ecuc integer param value PortPinId: value=5
              ecuc enumeration param value PortPinInitialMode: value=PORT_PIN_MODE_DIO
              ecuc enumeration param value PortPinLevelValue: value=PORT_PIN_LEVEL_HIGH
              ecuc enumeration param value PortPinMode: value=PORT_PIN_MODE_DIO
              ecuc boolean param value PortPinModeChangeable: value=0
              ecuc enumeration param value PortPinInputPullResistor: value=PORT_PIN_IN_PULL_UP
            PortPin_5: destination=AUTOSAR/Final_project_BSW/Port/PortConfigSet/PortContainer/PortContainer_0/PortPin/PortPin_5
              ecuc enumeration param value PortPinDirection
              ecuc boolean param value PortPinDirectionChangeable: value=0
              ecuc integer param value PortPinId: value=6
              ecuc enumeration param value PortPinInitialMode
              ecuc enumeration param value PortPinLevelValue
              ecuc enumeration param value PortPinMode
              ecuc boolean param value PortPinModeChangeable: value=0
              ecuc enumeration param value PortPinInputPullResistor: value=PORT_PIN_IN_NO_PULL
            PortPin_6: destination=AUTOSAR/Final_project_BSW/Port/PortConfigSet/PortContainer/PortContainer_0/PortPin/PortPin_6
              ecuc enumeration param value PortPinDirection
              ecuc boolean param value PortPinDirectionChangeable: value=0
              ecuc integer param value PortPinId: value=7
              ecuc enumeration param value PortPinInitialMode
              ecuc enumeration param value PortPinLevelValue
              ecuc enumeration param value PortPinMode
              ecuc boolean param value PortPinModeChangeable: value=0
              ecuc enumeration param value PortPinInputPullResistor: value=PORT_PIN_IN_NO_PULL
            PortPin_7: destination=AUTOSAR/Final_project_BSW/Port/PortConfigSet/PortContainer/PortContainer_0/PortPin/PortPin_7
              ecuc enumeration param value PortPinDirection
              ecuc boolean param value PortPinDirectionChangeable: value=0
              ecuc integer param value PortPinId: value=8
              ecuc enumeration param value PortPinInitialMode
              ecuc enumeration param value PortPinLevelValue
              ecuc enumeration param value PortPinMode
              ecuc boolean param value PortPinModeChangeable: value=0
              ecuc enumeration param value PortPinInputPullResistor: value=PORT_PIN_IN_NO_PULL
        PortContainer_1: destination=AUTOSAR/Final_project_BSW/Port/PortConfigSet/PortContainer/PortContainer_1
          ecuc integer param value PortNumberOfPortPins: value=2
          8 x ecuc param conf container:
            PortPin_0: destination=AUTOSAR/Final_project_BSW/Port/PortConfigSet/PortContainer/PortContainer_1/PortPin/PortPin_0
              ecuc enumeration param value PortPinDirection
              ecuc boolean param value PortPinDirectionChangeable: value=0
              ecuc integer param value PortPinId: value=9
              ecuc enumeration param value PortPinInitialMode
              ecuc enumeration param value PortPinLevelValue
              ecuc enumeration param value PortPinMode
              ecuc boolean param value PortPinModeChangeable: value=0
              ecuc enumeration param value PortPinInputPullResistor: value=PORT_PIN_IN_NO_PULL
            PortPin_1: destination=AUTOSAR/Final_project_BSW/Port/PortConfigSet/PortContainer/PortContainer_1/PortPin/PortPin_1
              ecuc enumeration param value PortPinDirection
              ecuc boolean param value PortPinDirectionChangeable: value=0
              ecuc integer param value PortPinId: value=10
              ecuc enumeration param value PortPinInitialMode
              ecuc enumeration param value PortPinLevelValue
              ecuc enumeration param value PortPinMode
              ecuc boolean param value PortPinModeChangeable: value=0
              ecuc enumeration param value PortPinInputPullResistor: value=PORT_PIN_IN_NO_PULL
            PortPin_2: destination=AUTOSAR/Final_project_BSW/Port/PortConfigSet/PortContainer/PortContainer_1/PortPin/PortPin_2
              ecuc enumeration param value PortPinDirection
              ecuc boolean param value PortPinDirectionChangeable: value=0
              ecuc integer param value PortPinId: value=11
              ecuc enumeration param value PortPinInitialMode
              ecuc enumeration param value PortPinLevelValue
              ecuc enumeration param value PortPinMode
              ecuc boolean param value PortPinModeChangeable: value=0
              ecuc enumeration param value PortPinInputPullResistor: value=PORT_PIN_IN_NO_PULL
            PortPin_3: destination=AUTOSAR/Final_project_BSW/Port/PortConfigSet/PortContainer/PortContainer_1/PortPin/PortPin_3
              ecuc enumeration param value PortPinDirection
              ecuc boolean param value PortPinDirectionChangeable: value=0
              ecuc integer param value PortPinId: value=12
              ecuc enumeration param value PortPinInitialMode
              ecuc enumeration param value PortPinLevelValue
              ecuc enumeration param value PortPinMode
              ecuc boolean param value PortPinModeChangeable: value=0
              ecuc enumeration param value PortPinInputPullResistor: value=PORT_PIN_IN_NO_PULL
            PortPin_4: destination=AUTOSAR/Final_project_BSW/Port/PortConfigSet/PortContainer/PortContainer_1/PortPin/PortPin_4
              ecuc enumeration param value PortPinDirection
              ecuc boolean param value PortPinDirectionChangeable: value=0
              ecuc integer param value PortPinId: value=13
              ecuc enumeration param value PortPinInitialMode
              ecuc enumeration param value PortPinLevelValue
              ecuc enumeration param value PortPinMode
              ecuc boolean param value PortPinModeChangeable: value=0
              ecuc enumeration param value PortPinInputPullResistor: value=PORT_PIN_IN_NO_PULL
            PortPin_5: destination=AUTOSAR/Final_project_BSW/Port/PortConfigSet/PortContainer/PortContainer_1/PortPin/PortPin_5
              ecuc enumeration param value PortPinDirection
              ecuc boolean param value PortPinDirectionChangeable: value=0
              ecuc integer param value PortPinId: value=14
              ecuc enumeration param value PortPinInitialMode
              ecuc enumeration param value PortPinLevelValue
              ecuc enumeration param value PortPinMode
              ecuc boolean param value PortPinModeChangeable: value=0
              ecuc enumeration param value PortPinInputPullResistor: value=PORT_PIN_IN_NO_PULL
            PortPin_6: destination=AUTOSAR/Final_project_BSW/Port/PortConfigSet/PortContainer/PortContainer_1/PortPin/PortPin_6
              ecuc enumeration param value PortPinDirection
              ecuc boolean param value PortPinDirectionChangeable: value=0
              ecuc integer param value PortPinId: value=15
              ecuc enumeration param value PortPinInitialMode
              ecuc enumeration param value PortPinLevelValue
              ecuc enumeration param value PortPinMode
              ecuc boolean param value PortPinModeChangeable: value=0
              ecuc enumeration param value PortPinInputPullResistor: value=PORT_PIN_IN_NO_PULL
            PortPin_7: destination=AUTOSAR/Final_project_BSW/Port/PortConfigSet/PortContainer/PortContainer_1/PortPin/PortPin_7
              ecuc enumeration param value PortPinDirection
              ecuc boolean param value PortPinDirectionChangeable: value=0
              ecuc integer param value PortPinId: value=16
              ecuc enumeration param value PortPinInitialMode
              ecuc enumeration param value PortPinLevelValue
              ecuc enumeration param value PortPinMode
              ecuc boolean param value PortPinModeChangeable: value=0
              ecuc enumeration param value PortPinInputPullResistor: value=PORT_PIN_IN_NO_PULL
        PortContainer_2: destination=AUTOSAR/Final_project_BSW/Port/PortConfigSet/PortContainer/PortContainer_2
          ecuc integer param value PortNumberOfPortPins: value=3
          8 x ecuc param conf container:
            PortPin_0: destination=AUTOSAR/Final_project_BSW/Port/PortConfigSet/PortContainer/PortContainer_2/PortPin/PortPin_0
              ecuc enumeration param value PortPinDirection
              ecuc boolean param value PortPinDirectionChangeable: value=0
              ecuc integer param value PortPinId: value=17
              ecuc enumeration param value PortPinInitialMode
              ecuc enumeration param value PortPinLevelValue
              ecuc enumeration param value PortPinMode
              ecuc boolean param value PortPinModeChangeable: value=0
              ecuc enumeration param value PortPinInputPullResistor: value=PORT_PIN_IN_NO_PULL
            PortPin_1: destination=AUTOSAR/Final_project_BSW/Port/PortConfigSet/PortContainer/PortContainer_2/PortPin/PortPin_1
              ecuc enumeration param value PortPinDirection
              ecuc boolean param value PortPinDirectionChangeable: value=0
              ecuc integer param value PortPinId: value=18
              ecuc enumeration param value PortPinInitialMode
              ecuc enumeration param value PortPinLevelValue
              ecuc enumeration param value PortPinMode
              ecuc boolean param value PortPinModeChangeable: value=0
              ecuc enumeration param value PortPinInputPullResistor: value=PORT_PIN_IN_NO_PULL
            PortPin_2: destination=AUTOSAR/Final_project_BSW/Port/PortConfigSet/PortContainer/PortContainer_2/PortPin/PortPin_2
              ecuc enumeration param value PortPinDirection
              ecuc boolean param value PortPinDirectionChangeable: value=0
              ecuc integer param value PortPinId: value=19
              ecuc enumeration param value PortPinInitialMode
              ecuc enumeration param value PortPinLevelValue
              ecuc enumeration param value PortPinMode
              ecuc boolean param value PortPinModeChangeable: value=0
              ecuc enumeration param value PortPinInputPullResistor: value=PORT_PIN_IN_NO_PULL
            PortPin_3: destination=AUTOSAR/Final_project_BSW/Port/PortConfigSet/PortContainer/PortContainer_2/PortPin/PortPin_3
              ecuc enumeration param value PortPinDirection
              ecuc boolean param value PortPinDirectionChangeable: value=0
              ecuc integer param value PortPinId: value=20
              ecuc enumeration param value PortPinInitialMode
              ecuc enumeration param value PortPinLevelValue
              ecuc enumeration param value PortPinMode
              ecuc boolean param value PortPinModeChangeable: value=0
              ecuc enumeration param value PortPinInputPullResistor: value=PORT_PIN_IN_NO_PULL
            PortPin_4: destination=AUTOSAR/Final_project_BSW/Port/PortConfigSet/PortContainer/PortContainer_2/PortPin/PortPin_4
              ecuc enumeration param value PortPinDirection
              ecuc boolean param value PortPinDirectionChangeable: value=0
              ecuc integer param value PortPinId: value=21
              ecuc enumeration param value PortPinInitialMode
              ecuc enumeration param value PortPinLevelValue
              ecuc enumeration param value PortPinMode
              ecuc boolean param value PortPinModeChangeable: value=0
              ecuc enumeration param value PortPinInputPullResistor: value=PORT_PIN_IN_NO_PULL
            PortPin_5: destination=AUTOSAR/Final_project_BSW/Port/PortConfigSet/PortContainer/PortContainer_2/PortPin/PortPin_5
              ecuc enumeration param value PortPinDirection
              ecuc boolean param value PortPinDirectionChangeable: value=0
              ecuc integer param value PortPinId: value=22
              ecuc enumeration param value PortPinInitialMode
              ecuc enumeration param value PortPinLevelValue
              ecuc enumeration param value PortPinMode
              ecuc boolean param value PortPinModeChangeable: value=0
              ecuc enumeration param value PortPinInputPullResistor: value=PORT_PIN_IN_NO_PULL
            PortPin_6: destination=AUTOSAR/Final_project_BSW/Port/PortConfigSet/PortContainer/PortContainer_2/PortPin/PortPin_6
              ecuc enumeration param value PortPinDirection
              ecuc boolean param value PortPinDirectionChangeable: value=0
              ecuc integer param value PortPinId: value=23
              ecuc enumeration param value PortPinInitialMode
              ecuc enumeration param value PortPinLevelValue
              ecuc enumeration param value PortPinMode
              ecuc boolean param value PortPinModeChangeable: value=0
              ecuc enumeration param value PortPinInputPullResistor: value=PORT_PIN_IN_NO_PULL
            PortPin_7: destination=AUTOSAR/Final_project_BSW/Port/PortConfigSet/PortContainer/PortContainer_2/PortPin/PortPin_7
              ecuc enumeration param value PortPinDirection
              ecuc boolean param value PortPinDirectionChangeable: value=0
              ecuc integer param value PortPinId: value=24
              ecuc enumeration param value PortPinInitialMode
              ecuc enumeration param value PortPinLevelValue
              ecuc enumeration param value PortPinMode
              ecuc boolean param value PortPinModeChangeable: value=0
              ecuc enumeration param value PortPinInputPullResistor: value=PORT_PIN_IN_NO_PULL
        PortContainer_3: destination=AUTOSAR/Final_project_BSW/Port/PortConfigSet/PortContainer/PortContainer_3
          ecuc integer param value PortNumberOfPortPins: value=4
          8 x ecuc param conf container:
            PortPin_0: destination=AUTOSAR/Final_project_BSW/Port/PortConfigSet/PortContainer/PortContainer_3/PortPin/PortPin_0
              ecuc enumeration param value PortPinDirection
              ecuc boolean param value PortPinDirectionChangeable: value=0
              ecuc integer param value PortPinId: value=25
              ecuc enumeration param value PortPinInitialMode
              ecuc enumeration param value PortPinLevelValue
              ecuc enumeration param value PortPinMode
              ecuc boolean param value PortPinModeChangeable: value=0
              ecuc enumeration param value PortPinInputPullResistor: value=PORT_PIN_IN_NO_PULL
            PortPin_1: destination=AUTOSAR/Final_project_BSW/Port/PortConfigSet/PortContainer/PortContainer_3/PortPin/PortPin_1
              ecuc enumeration param value PortPinDirection
              ecuc boolean param value PortPinDirectionChangeable: value=0
              ecuc integer param value PortPinId: value=26
              ecuc enumeration param value PortPinInitialMode
              ecuc enumeration param value PortPinLevelValue
              ecuc enumeration param value PortPinMode
              ecuc boolean param value PortPinModeChangeable: value=0
              ecuc enumeration param value PortPinInputPullResistor: value=PORT_PIN_IN_NO_PULL
            PortPin_2: destination=AUTOSAR/Final_project_BSW/Port/PortConfigSet/PortContainer/PortContainer_3/PortPin/PortPin_2
              ecuc enumeration param value PortPinDirection
              ecuc boolean param value PortPinDirectionChangeable: value=0
              ecuc integer param value PortPinId: value=27
              ecuc enumeration param value PortPinInitialMode
              ecuc enumeration param value PortPinLevelValue
              ecuc enumeration param value PortPinMode
              ecuc boolean param value PortPinModeChangeable: value=0
              ecuc enumeration param value PortPinInputPullResistor: value=PORT_PIN_IN_NO_PULL
            PortPin_3: destination=AUTOSAR/Final_project_BSW/Port/PortConfigSet/PortContainer/PortContainer_3/PortPin/PortPin_3
              ecuc enumeration param value PortPinDirection
              ecuc boolean param value PortPinDirectionChangeable: value=0
              ecuc integer param value PortPinId: value=28
              ecuc enumeration param value PortPinInitialMode
              ecuc enumeration param value PortPinLevelValue
              ecuc enumeration param value PortPinMode
              ecuc boolean param value PortPinModeChangeable: value=0
              ecuc enumeration param value PortPinInputPullResistor: value=PORT_PIN_IN_NO_PULL
            PortPin_4: destination=AUTOSAR/Final_project_BSW/Port/PortConfigSet/PortContainer/PortContainer_3/PortPin/PortPin_4
              ecuc enumeration param value PortPinDirection
              ecuc boolean param value PortPinDirectionChangeable: value=0
              ecuc integer param value PortPinId: value=29
              ecuc enumeration param value PortPinInitialMode
              ecuc enumeration param value PortPinLevelValue
              ecuc enumeration param value PortPinMode
              ecuc boolean param value PortPinModeChangeable: value=0
              ecuc enumeration param value PortPinInputPullResistor: value=PORT_PIN_IN_NO_PULL
            PortPin_5: destination=AUTOSAR/Final_project_BSW/Port/PortConfigSet/PortContainer/PortContainer_3/PortPin/PortPin_5
              ecuc enumeration param value PortPinDirection
              ecuc boolean param value PortPinDirectionChangeable: value=0
              ecuc integer param value PortPinId: value=30
              ecuc enumeration param value PortPinInitialMode
              ecuc enumeration param value PortPinLevelValue
              ecuc enumeration param value PortPinMode
              ecuc boolean param value PortPinModeChangeable: value=0
              ecuc enumeration param value PortPinInputPullResistor: value=PORT_PIN_IN_NO_PULL
            PortPin_6: destination=AUTOSAR/Final_project_BSW/Port/PortConfigSet/PortContainer/PortContainer_3/PortPin/PortPin_6
              ecuc enumeration param value PortPinDirection
              ecuc boolean param value PortPinDirectionChangeable: value=0
              ecuc integer param value PortPinId: value=31
              ecuc enumeration param value PortPinInitialMode
              ecuc enumeration param value PortPinLevelValue
              ecuc enumeration param value PortPinMode
              ecuc boolean param value PortPinModeChangeable: value=0
              ecuc enumeration param value PortPinInputPullResistor: value=PORT_PIN_IN_NO_PULL
            PortPin_7: destination=AUTOSAR/Final_project_BSW/Port/PortConfigSet/PortContainer/PortContainer_3/PortPin/PortPin_7
              ecuc enumeration param value PortPinDirection
              ecuc boolean param value PortPinDirectionChangeable: value=0
              ecuc integer param value PortPinId: value=32
              ecuc enumeration param value PortPinInitialMode
              ecuc enumeration param value PortPinLevelValue
              ecuc enumeration param value PortPinMode
              ecuc boolean param value PortPinModeChangeable: value=0
              ecuc enumeration param value PortPinInputPullResistor: value=PORT_PIN_IN_NO_PULL
        PortContainer_4: destination=AUTOSAR/Final_project_BSW/Port/PortConfigSet/PortContainer/PortContainer_4
          ecuc integer param value PortNumberOfPortPins: value=5
          6 x ecuc param conf container:
            PortPin_0: destination=AUTOSAR/Final_project_BSW/Port/PortConfigSet/PortContainer/PortContainer_4/PortPin/PortPin_0
              ecuc enumeration param value PortPinDirection
              ecuc boolean param value PortPinDirectionChangeable: value=0
              ecuc integer param value PortPinId: value=33
              ecuc enumeration param value PortPinInitialMode
              ecuc enumeration param value PortPinLevelValue
              ecuc enumeration param value PortPinMode
              ecuc boolean param value PortPinModeChangeable: value=0
              ecuc enumeration param value PortPinInputPullResistor: value=PORT_PIN_IN_NO_PULL
            PortPin_1: destination=AUTOSAR/Final_project_BSW/Port/PortConfigSet/PortContainer/PortContainer_4/PortPin/PortPin_1
              ecuc enumeration param value PortPinDirection
              ecuc boolean param value PortPinDirectionChangeable: value=0
              ecuc integer param value PortPinId: value=34
              ecuc enumeration param value PortPinInitialMode
              ecuc enumeration param value PortPinLevelValue
              ecuc enumeration param value PortPinMode
              ecuc boolean param value PortPinModeChangeable: value=0
              ecuc enumeration param value PortPinInputPullResistor: value=PORT_PIN_IN_NO_PULL
            PortPin_2: destination=AUTOSAR/Final_project_BSW/Port/PortConfigSet/PortContainer/PortContainer_4/PortPin/PortPin_2
              ecuc enumeration param value PortPinDirection
              ecuc boolean param value PortPinDirectionChangeable: value=0
              ecuc integer param value PortPinId: value=35
              ecuc enumeration param value PortPinInitialMode
              ecuc enumeration param value PortPinLevelValue
              ecuc enumeration param value PortPinMode
              ecuc boolean param value PortPinModeChangeable: value=0
              ecuc enumeration param value PortPinInputPullResistor: value=PORT_PIN_IN_NO_PULL
            PortPin_3: destination=AUTOSAR/Final_project_BSW/Port/PortConfigSet/PortContainer/PortContainer_4/PortPin/PortPin_3
              ecuc enumeration param value PortPinDirection
              ecuc boolean param value PortPinDirectionChangeable: value=0
              ecuc integer param value PortPinId: value=36
              ecuc enumeration param value PortPinInitialMode
              ecuc enumeration param value PortPinLevelValue
              ecuc enumeration param value PortPinMode
              ecuc boolean param value PortPinModeChangeable: value=0
              ecuc enumeration param value PortPinInputPullResistor: value=PORT_PIN_IN_NO_PULL
            PortPin_4: destination=AUTOSAR/Final_project_BSW/Port/PortConfigSet/PortContainer/PortContainer_4/PortPin/PortPin_4
              ecuc enumeration param value PortPinDirection
              ecuc boolean param value PortPinDirectionChangeable: value=0
              ecuc integer param value PortPinId: value=37
              ecuc enumeration param value PortPinInitialMode
              ecuc enumeration param value PortPinLevelValue
              ecuc enumeration param value PortPinMode
              ecuc boolean param value PortPinModeChangeable: value=0
              ecuc enumeration param value PortPinInputPullResistor: value=PORT_PIN_IN_NO_PULL
            PortPin_5: destination=AUTOSAR/Final_project_BSW/Port/PortConfigSet/PortContainer/PortContainer_4/PortPin/PortPin_5
              ecuc enumeration param value PortPinDirection
              ecuc boolean param value PortPinDirectionChangeable: value=0
              ecuc integer param value PortPinId: value=38
              ecuc enumeration param value PortPinInitialMode
              ecuc enumeration param value PortPinLevelValue
              ecuc enumeration param value PortPinMode
              ecuc boolean param value PortPinModeChangeable: value=0
              ecuc enumeration param value PortPinInputPullResistor: value=PORT_PIN_IN_NO_PULL
        PortContainer_6: destination=AUTOSAR/Final_project_BSW/Port/PortConfigSet/PortContainer/PortContainer_6
          ecuc integer param value PortNumberOfPortPins: value=6
          5 x ecuc param conf container:
            PortPin_0: destination=AUTOSAR/Final_project_BSW/Port/PortConfigSet/PortContainer/PortContainer_6/PortPin/PortPin_0
              ecuc enumeration param value PortPinDirection: value=PORT_PIN_IN
              ecuc boolean param value PortPinDirectionChangeable: value=0
              ecuc integer param value PortPinId: value=39
              ecuc enumeration param value PortPinInitialMode: value=PORT_PIN_MODE_DIO
              ecuc enumeration param value PortPinLevelValue: value=PORT_PIN_LEVEL_HIGH
              ecuc enumeration param value PortPinMode: value=PORT_PIN_MODE_DIO
              ecuc boolean param value PortPinModeChangeable: value=0
              ecuc enumeration param value PortPinInputPullResistor: value=PORT_PIN_IN_PULL_UP
            PortPin_1: destination=AUTOSAR/Final_project_BSW/Port/PortConfigSet/PortContainer/PortContainer_6/PortPin/PortPin_1
              ecuc enumeration param value PortPinDirection: value=PORT_PIN_OUT
              ecuc boolean param value PortPinDirectionChangeable: value=0
              ecuc integer param value PortPinId: value=40
              ecuc enumeration param value PortPinInitialMode: value=PORT_PIN_MODE_DIO
              ecuc enumeration param value PortPinLevelValue: value=PORT_PIN_LEVEL_LOW
              ecuc enumeration param value PortPinMode: value=PORT_PIN_MODE_DIO
              ecuc boolean param value PortPinModeChangeable: value=0
              ecuc enumeration param value PortPinInputPullResistor
            PortPin_2: destination=AUTOSAR/Final_project_BSW/Port/PortConfigSet/PortContainer/PortContainer_6/PortPin/PortPin_2
              ecuc enumeration param value PortPinDirection: value=PORT_PIN_OUT
              ecuc boolean param value PortPinDirectionChangeable: value=0
              ecuc integer param value PortPinId: value=41
              ecuc enumeration param value PortPinInitialMode: value=PORT_PIN_MODE_DIO
              ecuc enumeration param value PortPinLevelValue: value=PORT_PIN_LEVEL_LOW
              ecuc enumeration param value PortPinMode: value=PORT_PIN_MODE_DIO
              ecuc boolean param value PortPinModeChangeable: value=0
              ecuc enumeration param value PortPinInputPullResistor
            PortPin_3: destination=AUTOSAR/Final_project_BSW/Port/PortConfigSet/PortContainer/PortContainer_6/PortPin/PortPin_3
              ecuc enumeration param value PortPinDirection: value=PORT_PIN_OUT
              ecuc boolean param value PortPinDirectionChangeable: value=0
              ecuc integer param value PortPinId: value=42
              ecuc enumeration param value PortPinInitialMode: value=PORT_PIN_MODE_DIO
              ecuc enumeration param value PortPinLevelValue: value=PORT_PIN_LEVEL_LOW
              ecuc enumeration param value PortPinMode: value=PORT_PIN_MODE_DIO
              ecuc boolean param value PortPinModeChangeable: value=0
              ecuc enumeration param value PortPinInputPullResistor
            PortPin_4: destination=AUTOSAR/Final_project_BSW/Port/PortConfigSet/PortContainer/PortContainer_6/PortPin/PortPin_4
              ecuc enumeration param value PortPinDirection: value=PORT_PIN_IN
              ecuc boolean param value PortPinDirectionChangeable: value=0
              ecuc integer param value PortPinId: value=43
              ecuc enumeration param value PortPinInitialMode: value=PORT_PIN_MODE_DIO
              ecuc enumeration param value PortPinLevelValue: value=PORT_PIN_LEVEL_HIGH
              ecuc enumeration param value PortPinMode: value=PORT_PIN_MODE_DIO
              ecuc boolean param value PortPinModeChangeable: value=0
              ecuc enumeration param value PortPinInputPullResistor: value=PORT_PIN_IN_PULL_UP
    ecuc param conf container PortGeneral: destination=AUTOSAR/Final_project_BSW/Port/PortGeneral
      4 x ecuc boolean param value:
        PortDevErrorDetect: value=0
        PortSetPinDirectionApi: value=1
        PortSetPinModeApi: value=1
        PortVersionInfoApi: value=0
